/*
 * CAUTION: This file is automatically generated by Xilinx.
 * Version: XSCT 2018.3
 * Today is: Thu Jul 31 20:00:34 2025
 */


/dts-v1/;
#include "zynq-7000.dtsi"
#include "pl.dtsi"
#include "pcw.dtsi"
/ {
	chosen {
		bootargs = "earlycon";
		stdout-path = "serial0:115200n8";
	};
	aliases {
		ethernet0 = &gem0;
		i2c0 = &i2c1;
		serial0 = &uart1;
		serial1 = &axi_uartlite_0;
		spi0 = &spi0;
	};
	memory@0 {
		device_type = "memory";
		reg = <0x0 0x20000000>;
	};
};
